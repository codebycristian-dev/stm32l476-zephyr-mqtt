## CMakeLists.txt
```
cmake_minimum_required(VERSION 3.20.0)

find_package(Zephyr REQUIRED HINTS $ENV{ZEPHYR_BASE})
project(stm32l476_zephyr_mqtt LANGUAGES C)

target_sources(app PRIVATE
  src/main.c
  src/byte_ring.c
  src/espat_evidence.c
  src/espat_response.c
  src/usart1_transport.c
)
target_include_directories(app PRIVATE include)
```

## Kconfig
```
mainmenu "stm32l476-zephyr-mqtt"

config APP_USART1_LOOPBACK
	bool "Run bounded PA9-to-PA10 physical loopback verification"
	default n
	help
	  Requires PA9 to be physically connected to PA10. Results are logged on
	  the unchanged USART2/ST-LINK console. Do not enable for normal firmware.

config APP_ESPAT_AT_DIAGNOSTIC
	bool "Run bounded ESP-AT identity diagnostic on USART1"
	default y
	depends on !APP_USART1_LOOPBACK
	help
	  Sends AT followed by CRLF and requires final OK before sending AT+GMR
	  followed by CRLF. Each response uses a fixed 512-byte capture and a
	  bounded deadline. After a one-second diagnostic-only startup delay, one
	  delimited evidence record is written synchronously through USART2/ST-LINK
	  so mandatory evidence cannot overflow Zephyr's deferred logger queue.

source "Kconfig.zephyr"
```

## prj.conf
```kconfig
# Keep diagnostics on the board-defined USART2/ST-LINK console.
CONFIG_CONSOLE=y
CONFIG_UART_CONSOLE=y
CONFIG_SERIAL=y
CONFIG_LOG=y
CONFIG_LOG_DEFAULT_LEVEL=3
# Diagnostic status and the direct evidence writer share USART2. Immediate mode
# prevents a deferred log worker from interleaving with the evidence record.
CONFIG_LOG_MODE_IMMEDIATE=y
CONFIG_GPIO=y

# The synchronous evidence path runs on the main thread. Target disassembly
# bounds its application frames, but Zephyr printk adds formatter depth; 1536
# leaves measured fault-relative headroom without enlarging evidence storage.
CONFIG_MAIN_STACK_SIZE=1536

# USART1 is owned exclusively by the direct-CMSIS transport. USART2 remains
# Zephyr's board-defined ST-LINK console.
CONFIG_APP_USART1_LOOPBACK=n
CONFIG_APP_ESPAT_AT_DIAGNOSTIC=y
```

## boards/nucleo_l476rg.overlay
```dts
/* USART1 belongs to the direct-CMSIS transport; USART2 remains the console. */
&usart1 {
	status = "disabled";
};

/ {
	chosen {
		zephyr,console = &usart2;
	};
};
```

## src/main.c
```c
#include <zephyr/device.h>
#include <zephyr/devicetree.h>
#include <zephyr/drivers/gpio.h>
#include <zephyr/kernel.h>
#include <zephyr/logging/log.h>
#include <zephyr/sys/printk.h>

#include <string.h>

#include "usart1_transport.h"
#include "espat_evidence.h"
#include "espat_response.h"

LOG_MODULE_REGISTER(app, LOG_LEVEL_INF);

#define USER_LED_NODE DT_ALIAS(led0)
#define LED_PERIOD_MS 500
#define LOOPBACK_TIMEOUT_MS 1000
#define ESPAT_AT_TIMEOUT_MS 1000
#define ESPAT_GMR_TIMEOUT_MS 2000
#define ESPAT_DIAGNOSTIC_STARTUP_DELAY_MS 1000

#if CONFIG_APP_ESPAT_AT_DIAGNOSTIC
static void run_espat_command(const uint8_t *command, size_t command_length,
			      int32_t timeout_ms,
			      struct espat_transaction_evidence *evidence)
{
	int64_t deadline;
	uint8_t byte;

	espat_response_init(&evidence->response);
	evidence->tx_count = command_length;
	evidence->executed = true;
	if (usart1_transport_write(command, command_length) < 0) {
		evidence->transmit_failed = true;
		return;
	}
	deadline = k_uptime_get() + timeout_ms;
	while (!espat_response_complete(&evidence->response) &&
	       !evidence->response.overflow &&
	       k_uptime_get() < deadline) {
		if (usart1_transport_read(&byte)) {
			espat_response_feed(&evidence->response, byte);
		} else {
			k_msleep(1);
		}
	}
	espat_response_finish(&evidence->response);
	evidence->timed_out = evidence->response.final == ESPAT_FINAL_NONE &&
			      !evidence->response.overflow;
	usart1_transport_get_errors(&evidence->errors);
}

static void evidence_console_write(const char *data, size_t length, void *context)
{
	ARG_UNUSED(context);
	for (size_t i = 0U; i < length; i++) {
		printk("%c", data[i]);
	}
}

static void run_espat_at_diagnostic(void)
{
	static const uint8_t at_command[] = {'A', 'T', '\r', '\n'};
	static const uint8_t gmr_command[] = {'A', 'T', '+', 'G', 'M', 'R', '\r', '\n'};
	static struct espat_transaction_evidence at_evidence = {.name = "AT"};
	static struct espat_transaction_evidence gmr_evidence = {.name = "AT+GMR"};

	/* Give a host time to open the ST-LINK VCP after normal boot. Mandatory
	 * evidence bypasses log formatting and is emitted synchronously.
	 */
	k_msleep(ESPAT_DIAGNOSTIC_STARTUP_DELAY_MS);
	run_espat_command(at_command, sizeof(at_command), ESPAT_AT_TIMEOUT_MS,
			  &at_evidence);
	if (espat_evidence_allows_gmr(&at_evidence)) {
		run_espat_command(gmr_command, sizeof(gmr_command),
				  ESPAT_GMR_TIMEOUT_MS, &gmr_evidence);
	}
	espat_evidence_emit(&at_evidence, &gmr_evidence,
			    evidence_console_write, NULL);
}
#endif

#if CONFIG_APP_USART1_LOOPBACK
static int run_loopback_case(const char *name, const uint8_t *payload, size_t length)
{
	uint8_t received[USART1_RX_CAPACITY];
	size_t count = 0U;
	int64_t deadline = k_uptime_get() + LOOPBACK_TIMEOUT_MS;

	if (length > sizeof(received) || usart1_transport_write(payload, length) < 0) {
		LOG_ERR("USART1 loopback %s: transmit rejected", name);
		return -1;
	}
	while (count < length && k_uptime_get() < deadline) {
		if (usart1_transport_read(&received[count])) {
			count++;
		} else {
			k_msleep(1);
		}
	}
	if (count != length || memcmp(payload, received, length) != 0) {
		LOG_ERR("USART1 loopback %s: mismatch (%u/%u bytes)", name,
			(unsigned int)count, (unsigned int)length);
		return -1;
	}
	LOG_INF("USART1 loopback %s: PASS (%u bytes)", name, (unsigned int)length);
	return 0;
}

static int run_physical_loopback(void)
{
	static const uint8_t short_payload[] = {'L', '4', '7', '6', '!'};
	static const uint8_t binary_payload[] = {0x00, 0x01, 0x7f, 0x80, 0xfe, 0xff, '\r', '\n'};
	static const uint8_t wrap_payload[56] = {
		0x30, 0x31, 0x32, 0x33, 0x34, 0x35, 0x36, 0x37,
		0x38, 0x39, 0x3a, 0x3b, 0x3c, 0x3d, 0x3e, 0x3f,
		0x40, 0x41, 0x42, 0x43, 0x44, 0x45, 0x46, 0x47,
		0x48, 0x49, 0x4a, 0x4b, 0x4c, 0x4d, 0x4e, 0x4f,
		0x50, 0x51, 0x52, 0x53, 0x54, 0x55, 0x56, 0x57,
		0x58, 0x59, 0x5a, 0xa0, 0xa1, 0xa2, 0xa3, 0xa4,
		0xa5, 0xa6, 0xa7, 0xa8, 0xa9, 0xaa, 0xab, 0xac,
	};
	struct usart1_error_counters errors;

	LOG_INF("USART1 physical loopback mode: PA9 must be connected to PA10");
	if (run_loopback_case("short", short_payload, sizeof(short_payload)) < 0 ||
	    run_loopback_case("binary", binary_payload, sizeof(binary_payload)) < 0 ||
	    run_loopback_case("ring-wrap", wrap_payload, sizeof(wrap_payload)) < 0) {
		return -1;
	}
	usart1_transport_get_errors(&errors);
	if (errors.parity != 0U || errors.framing != 0U || errors.noise != 0U ||
	    errors.overrun != 0U || errors.ring_overflow != 0U) {
		LOG_ERR("USART1 loopback errors: PE=%u FE=%u NE=%u ORE=%u ring=%u",
			(unsigned int)errors.parity, (unsigned int)errors.framing,
			(unsigned int)errors.noise, (unsigned int)errors.overrun,
			(unsigned int)errors.ring_overflow);
		return -1;
	}
	LOG_INF("USART1 physical loopback suite: PASS; all error counters zero");
	return 0;
}
#endif

int main(void)
{
	struct usart1_clock_info usart_clock;
	int usart_result;

	LOG_INF("stm32l476-zephyr-mqtt foundation starting");
	usart_result = usart1_transport_init();
	if (usart_result < 0) {
		LOG_ERR("USART1 direct-CMSIS initialization failed (%d)", usart_result);
		return 0;
	}
	usart1_transport_get_clock(&usart_clock);
	LOG_INF("USART1 ready: source=%u sysclk=%u pclk2=%u APB2div=%u peripheral=%u BRR=%u baud=%u",
		usart_clock.usart1_clock_source, usart_clock.sysclk_hz,
		usart_clock.pclk2_hz, usart_clock.apb2_divisor,
		usart_clock.peripheral_hz, usart_clock.brr, usart_clock.nominal_baud);

#if CONFIG_APP_USART1_LOOPBACK
	if (run_physical_loopback() < 0) {
		return 0;
	}
#endif

#if CONFIG_APP_ESPAT_AT_DIAGNOSTIC
	run_espat_at_diagnostic();
#endif

#if !DT_NODE_HAS_STATUS(USER_LED_NODE, okay)
	LOG_ERR("user LED devicetree alias 'led0' is missing or disabled");
	return 0;
#else
	static const struct gpio_dt_spec user_led =
		GPIO_DT_SPEC_GET(USER_LED_NODE, gpios);
	int ret;

	if (!gpio_is_ready_dt(&user_led)) {
		LOG_ERR("user LED GPIO device is not ready");
		return 0;
	}

	ret = gpio_pin_configure_dt(&user_led, GPIO_OUTPUT_INACTIVE);
	if (ret < 0) {
		LOG_ERR("failed to configure user LED GPIO (%d)", ret);
		return 0;
	}

	LOG_INF("user LED toggling every %d ms", LED_PERIOD_MS);
	for (;;) {
		ret = gpio_pin_toggle_dt(&user_led);
		if (ret < 0) {
			LOG_ERR("failed to toggle user LED GPIO (%d)", ret);
			return 0;
		}
		k_msleep(LED_PERIOD_MS);
	}
#endif
}
```

## include/byte_ring.h
```c
#ifndef BYTE_RING_H
#define BYTE_RING_H

#include <stdbool.h>
#include <stddef.h>
#include <stdint.h>

/* Capacity must be a power of two and is fully usable. */
#define BYTE_RING_CAPACITY 64U

struct byte_ring {
	uint8_t data[BYTE_RING_CAPACITY];
	uint32_t head;
	uint32_t tail;
};

void byte_ring_init(struct byte_ring *ring);
bool byte_ring_push(struct byte_ring *ring, uint8_t byte);
bool byte_ring_pop(struct byte_ring *ring, uint8_t *byte);
size_t byte_ring_count(const struct byte_ring *ring);
void saturating_increment_u32(uint32_t *counter);

#endif
```

## include/espat_evidence.h
```c
#ifndef ESPAT_EVIDENCE_H
#define ESPAT_EVIDENCE_H

#include <stdbool.h>
#include <stddef.h>

#include "espat_response.h"
#include "usart1_transport.h"

struct espat_transaction_evidence {
	const char *name;
	size_t tx_count;
	struct espat_response response;
	struct usart1_error_counters errors;
	bool executed;
	bool transmit_failed;
	bool timed_out;
};

typedef void (*espat_evidence_write_fn)(const char *data, size_t length,
					void *context);

const char *espat_evidence_classification(
	const struct espat_transaction_evidence *evidence);
bool espat_evidence_allows_gmr(
	const struct espat_transaction_evidence *at_evidence);
void espat_evidence_emit(const struct espat_transaction_evidence *at_evidence,
			 const struct espat_transaction_evidence *gmr_evidence,
			 espat_evidence_write_fn write, void *context);

#endif
```

## include/espat_response.h
```c
#ifndef ESPAT_RESPONSE_H
#define ESPAT_RESPONSE_H

#include <stdbool.h>
#include <stddef.h>
#include <stdint.h>

#define ESPAT_RESPONSE_CAPACITY 512U
#define ESPAT_LINE_CAPACITY 160U
#define ESPAT_IDENTITY_CAPACITY 96U

enum espat_final_result {
	ESPAT_FINAL_NONE,
	ESPAT_FINAL_OK,
	ESPAT_FINAL_ERROR,
};

struct espat_response {
	uint8_t bytes[ESPAT_RESPONSE_CAPACITY];
	size_t length;
	size_t line_length;
	uint8_t line[ESPAT_LINE_CAPACITY];
	unsigned int echo_count;
	unsigned int unsolicited_count;
	unsigned int prompt_count;
	enum espat_final_result final;
	bool overflow;
	bool ended_with_lf;
};

struct espat_identity {
	char esp_at[ESPAT_IDENTITY_CAPACITY];
	char esp_idf[ESPAT_IDENTITY_CAPACITY];
};

void espat_response_init(struct espat_response *response);
void espat_response_feed(struct espat_response *response, uint8_t byte);
void espat_response_finish(struct espat_response *response);
bool espat_response_complete(const struct espat_response *response);
void espat_response_extract_identity(const struct espat_response *response,
				     struct espat_identity *identity);

#endif
```

## include/usart1_transport.h
```c
#ifndef USART1_TRANSPORT_H
#define USART1_TRANSPORT_H

#include <stdbool.h>
#include <stddef.h>
#include <stdint.h>

#include "byte_ring.h"

#define USART1_RX_CAPACITY BYTE_RING_CAPACITY
#define USART1_BAUD_RATE 115200U

struct usart1_error_counters {
	uint32_t parity;
	uint32_t framing;
	uint32_t noise;
	uint32_t overrun;
	uint32_t ring_overflow;
};

struct usart1_clock_info {
	uint32_t sysclk_hz;
	uint32_t pclk2_hz;
	uint32_t peripheral_hz;
	uint32_t brr;
	uint32_t nominal_baud;
	uint8_t usart1_clock_source;
	uint8_t apb2_divisor;
};

/* Returns 0, or a negative errno value if the live clock state is invalid. */
int usart1_transport_init(void);

/* Synchronous, binary-safe, application-context-only transmission. The call
 * returns after TC proves the final stop bit has left PA9. Empty buffers are
 * accepted; NULL is rejected when length is nonzero.
 */
int usart1_transport_write(const uint8_t *data, size_t length);

/* Non-blocking: true means one byte was returned, false means empty/bad arg. */
bool usart1_transport_read(uint8_t *byte);
size_t usart1_transport_rx_count(void);
void usart1_transport_get_errors(struct usart1_error_counters *snapshot);
void usart1_transport_get_clock(struct usart1_clock_info *snapshot);

#endif
```

## src/byte_ring.c
```c
#include "byte_ring.h"

#include <limits.h>

#define BYTE_RING_MASK (BYTE_RING_CAPACITY - 1U)

_Static_assert((BYTE_RING_CAPACITY & BYTE_RING_MASK) == 0U,
	       "BYTE_RING_CAPACITY must be a power of two");

void byte_ring_init(struct byte_ring *ring)
{
	ring->head = 0U;
	ring->tail = 0U;
}

bool byte_ring_push(struct byte_ring *ring, uint8_t byte)
{
	uint32_t head = __atomic_load_n(&ring->head, __ATOMIC_RELAXED);
	uint32_t tail = __atomic_load_n(&ring->tail, __ATOMIC_ACQUIRE);

	if ((uint32_t)(head - tail) == BYTE_RING_CAPACITY) {
		return false;
	}

	ring->data[head & BYTE_RING_MASK] = byte;
	__atomic_store_n(&ring->head, head + 1U, __ATOMIC_RELEASE);
	return true;
}

bool byte_ring_pop(struct byte_ring *ring, uint8_t *byte)
{
	uint32_t tail;
	uint32_t head;

	if (byte == NULL) {
		return false;
	}

	tail = __atomic_load_n(&ring->tail, __ATOMIC_RELAXED);
	head = __atomic_load_n(&ring->head, __ATOMIC_ACQUIRE);
	if (tail == head) {
		return false;
	}

	*byte = ring->data[tail & BYTE_RING_MASK];
	__atomic_store_n(&ring->tail, tail + 1U, __ATOMIC_RELEASE);
	return true;
}

size_t byte_ring_count(const struct byte_ring *ring)
{
	uint32_t head = __atomic_load_n(&ring->head, __ATOMIC_ACQUIRE);
	uint32_t tail = __atomic_load_n(&ring->tail, __ATOMIC_ACQUIRE);

	return (size_t)(head - tail);
}

void saturating_increment_u32(uint32_t *counter)
{
	if (*counter != UINT32_MAX) {
		(*counter)++;
	}
}
```

## src/espat_evidence.c
```c
#include "espat_evidence.h"

#include <stdint.h>
#include <string.h>

#define EMIT_CHUNK_CAPACITY 64U

static bool has_uart_error(const struct usart1_error_counters *errors)
{
	return errors->parity != 0U || errors->framing != 0U ||
	       errors->noise != 0U || errors->overrun != 0U ||
	       errors->ring_overflow != 0U;
}

const char *espat_evidence_classification(
	const struct espat_transaction_evidence *evidence)
{
	if (evidence == NULL || !evidence->executed) {
		return "NOT_EXECUTED";
	}
	if (evidence->response.overflow) {
		return "OVERFLOW";
	}
	if (evidence->transmit_failed) {
		return "TX_ERROR";
	}
	if (has_uart_error(&evidence->errors)) {
		return "UART_ERROR";
	}
	if (evidence->response.final == ESPAT_FINAL_OK) {
		return "OK";
	}
	if (evidence->response.final == ESPAT_FINAL_ERROR) {
		return "ERROR";
	}
	return "TIMEOUT";
}

bool espat_evidence_allows_gmr(
	const struct espat_transaction_evidence *at_evidence)
{
	return at_evidence != NULL && at_evidence->executed &&
	       at_evidence->response.final == ESPAT_FINAL_OK &&
	       !at_evidence->transmit_failed && !at_evidence->timed_out &&
	       !at_evidence->response.overflow &&
	       !has_uart_error(&at_evidence->errors);
}

static void emit_text(espat_evidence_write_fn write, void *context,
		      const char *text)
{
	write(text, strlen(text), context);
}

static void emit_unsigned(espat_evidence_write_fn write, void *context,
			  uint32_t value)
{
	char digits[10];
	size_t length = 0U;

	do {
		digits[length++] = (char)('0' + value % 10U);
		value /= 10U;
	} while (value != 0U);
	for (size_t i = 0U; i < length / 2U; i++) {
		char temporary = digits[i];

		digits[i] = digits[length - 1U - i];
		digits[length - 1U - i] = temporary;
	}
	write(digits, length, context);
}

static void emit_field(espat_evidence_write_fn write, void *context,
		       const char *name, uint32_t value)
{
	emit_text(write, context, " ");
	emit_text(write, context, name);
	emit_text(write, context, "=");
	emit_unsigned(write, context, value);
}

static void emit_hex(const struct espat_response *response,
		     espat_evidence_write_fn write, void *context)
{
	static const char digits[] = "0123456789ABCDEF";
	char chunk[EMIT_CHUNK_CAPACITY];
	size_t used = 0U;

	for (size_t i = 0U; i < response->length; i++) {
		uint8_t value = response->bytes[i];
		char encoded[3] = {
			digits[value >> 4], digits[value & 0x0fU],
			i + 1U < response->length ? ' ' : '\0'
		};
		size_t count = i + 1U < response->length ? 3U : 2U;

		if (used + count > sizeof(chunk)) {
			write(chunk, used, context);
			used = 0U;
		}
		memcpy(&chunk[used], encoded, count);
		used += count;
	}
	if (used != 0U) {
		write(chunk, used, context);
	}
}

static void emit_printable(const struct espat_response *response,
			   espat_evidence_write_fn write, void *context)
{
	char chunk[EMIT_CHUNK_CAPACITY];
	size_t used = 0U;

	for (size_t i = 0U; i < response->length; i++) {
		uint8_t value = response->bytes[i];

		chunk[used++] = value >= 0x20U && value <= 0x7eU ?
			(char)value : '.';
		if (used == sizeof(chunk)) {
			write(chunk, used, context);
			used = 0U;
		}
	}
	if (used != 0U) {
		write(chunk, used, context);
	}
}

static void emit_identity_line(const struct espat_response *response,
			       const char *prefix,
			       espat_evidence_write_fn write, void *context)
{
	size_t prefix_length = strlen(prefix);
	size_t start = 0U;

	for (size_t i = 0U; i <= response->length; i++) {
		bool at_end = i == response->length;
		uint8_t byte = at_end ? '\n' : response->bytes[i];
		size_t length;

		if (byte != '\r' && byte != '\n') {
			continue;
		}
		length = i - start;
		if (length >= prefix_length &&
		    memcmp(&response->bytes[start], prefix, prefix_length) == 0) {
			/* Match the existing bounded identity-field behavior without
			 * constructing a second copy on the main thread stack.
			 */
			length = length < ESPAT_IDENTITY_CAPACITY - 1U ?
				length : ESPAT_IDENTITY_CAPACITY - 1U;
			write((const char *)&response->bytes[start], length, context);
			return;
		}
		start = i + 1U;
	}
	emit_text(write, context, "unavailable");
}

static void emit_transaction(const struct espat_transaction_evidence *evidence,
			     espat_evidence_write_fn write, void *context)
{
	emit_text(write, context, evidence->name);
	emit_field(write, context, "executed", evidence->executed);
	if (!evidence->executed) {
		emit_text(write, context, "\n");
		return;
	}
	emit_field(write, context, "tx", (uint32_t)evidence->tx_count);
	emit_field(write, context, "rx", (uint32_t)evidence->response.length);
	emit_text(write, context, " result=");
	emit_text(write, context, espat_evidence_classification(evidence));
	emit_field(write, context, "timeout", evidence->timed_out);
	emit_field(write, context, "tx_error", evidence->transmit_failed);
	emit_field(write, context, "overflow", evidence->response.overflow);
	emit_field(write, context, "truncated", evidence->response.overflow);
	emit_field(write, context, "echo", evidence->response.echo_count);
	emit_field(write, context, "urc", evidence->response.unsolicited_count);
	emit_field(write, context, "prompts", evidence->response.prompt_count);
	emit_field(write, context, "PE", evidence->errors.parity);
	emit_field(write, context, "FE", evidence->errors.framing);
	emit_field(write, context, "NE", evidence->errors.noise);
	emit_field(write, context, "ORE", evidence->errors.overrun);
	emit_field(write, context, "ring_overflow", evidence->errors.ring_overflow);
	emit_text(write, context, "\n");
	emit_text(write, context, evidence->name);
	emit_text(write, context, " rx_hex=");
	emit_hex(&evidence->response, write, context);
	emit_text(write, context, "\n");
	emit_text(write, context, evidence->name);
	emit_text(write, context, " rx_printable=");
	emit_printable(&evidence->response, write, context);
	emit_text(write, context, "\n");
}

void espat_evidence_emit(const struct espat_transaction_evidence *at_evidence,
			 const struct espat_transaction_evidence *gmr_evidence,
			 espat_evidence_write_fn write, void *context)
{
	if (at_evidence == NULL || gmr_evidence == NULL || write == NULL) {
		return;
	}
	emit_text(write, context, "ESPAT_EVIDENCE_BEGIN v=1 capacity=512\n");
	emit_transaction(at_evidence, write, context);
	emit_transaction(gmr_evidence, write, context);
	if (gmr_evidence->executed) {
		emit_text(write, context, "AT+GMR at_version=");
		emit_identity_line(&gmr_evidence->response, "AT version:",
				   write, context);
		emit_text(write, context, "\nAT+GMR sdk_version=");
		emit_identity_line(&gmr_evidence->response, "SDK version:",
				   write, context);
		emit_text(write, context, "\n");
	}
	emit_text(write, context, "ESPAT_EVIDENCE_END\n");
}
```

## src/espat_response.c
```c
#include "espat_response.h"

#include <string.h>

static bool line_equals(const struct espat_response *response, const char *text)
{
	size_t length = strlen(text);

	return response->line_length == length &&
	       memcmp(response->line, text, length) == 0;
}

static bool line_is_echo(const struct espat_response *response)
{
	return line_equals(response, "AT") || line_equals(response, "AT+GMR");
}

static void classify_line(struct espat_response *response)
{
	if (response->line_length == 0U) {
		return;
	}
	if (line_is_echo(response)) {
		response->echo_count++;
	} else if (response->line[0] == '>') {
		/* Prompts are counted as bytes arrive, not as unsolicited lines. */
	} else if (line_equals(response, "OK")) {
		response->final = ESPAT_FINAL_OK;
	} else if (line_equals(response, "ERROR") || line_equals(response, "FAIL")) {
		response->final = ESPAT_FINAL_ERROR;
	} else {
		response->unsolicited_count++;
	}
	response->line_length = 0U;
}

void espat_response_init(struct espat_response *response)
{
	if (response != NULL) {
		*response = (struct espat_response){0};
	}
}

void espat_response_feed(struct espat_response *response, uint8_t byte)
{
	if (response == NULL) {
		return;
	}
	if (response->length < sizeof(response->bytes)) {
		response->bytes[response->length++] = byte;
	} else {
		response->overflow = true;
	}
	response->ended_with_lf = byte == '\n';
	if (byte == '>') {
		response->prompt_count++;
	}
	if (byte == '\r' || byte == '\n') {
		classify_line(response);
	} else if (response->line_length < sizeof(response->line)) {
		response->line[response->line_length++] = byte;
	} else {
		response->overflow = true;
	}
}

void espat_response_finish(struct espat_response *response)
{
	if (response != NULL) {
		classify_line(response);
	}
}

bool espat_response_complete(const struct espat_response *response)
{
	return response != NULL && response->final != ESPAT_FINAL_NONE &&
	       response->ended_with_lf;
}


static void copy_identity_line(char *destination, const uint8_t *line, size_t length)
{
	size_t copy_length = length < ESPAT_IDENTITY_CAPACITY - 1U ?
		length : ESPAT_IDENTITY_CAPACITY - 1U;

	memcpy(destination, line, copy_length);
	destination[copy_length] = '\0';
}

void espat_response_extract_identity(const struct espat_response *response,
				     struct espat_identity *identity)
{
	size_t start = 0U;

	if (identity == NULL) {
		return;
	}
	*identity = (struct espat_identity){0};
	if (response == NULL) {
		return;
	}
	for (size_t i = 0U; i <= response->length; i++) {
		bool at_end = i == response->length;
		uint8_t byte = at_end ? '\n' : response->bytes[i];
		size_t length;

		if (byte != '\r' && byte != '\n') {
			continue;
		}
		length = i - start;
		if (length >= 11U && memcmp(&response->bytes[start], "AT version:", 11U) == 0) {
			copy_identity_line(identity->esp_at, &response->bytes[start], length);
		} else if (length >= 12U &&
			   memcmp(&response->bytes[start], "SDK version:", 12U) == 0) {
			copy_identity_line(identity->esp_idf, &response->bytes[start], length);
		}
		start = i + 1U;
	}
}
```

## src/usart1_transport.c
```c
#include "usart1_transport.h"

#include <errno.h>

#include <zephyr/devicetree.h>
#include <zephyr/irq.h>
#include <zephyr/kernel.h>
#include <zephyr/sys/util.h>

#include <stm32l476xx.h>

#define HSI16_HZ 16000000U
#define LSE_HZ DT_PROP_OR(DT_NODELABEL(clk_lse), clock_frequency, 0U)
/* Zero means HSE is not described/enabled for this board; selecting it at
 * runtime is then rejected rather than guessed.
 */
#define HSE_HZ DT_PROP_OR(DT_NODELABEL(clk_hse), clock_frequency, 0U)
#define USART1_ERROR_FLAGS (USART_ISR_PE | USART_ISR_FE | USART_ISR_NE | USART_ISR_ORE)
#define USART1_ERROR_CLEARS (USART_ICR_PECF | USART_ICR_FECF | USART_ICR_NCF | USART_ICR_ORECF)

static struct byte_ring rx_ring;
static struct usart1_error_counters errors;
static struct usart1_clock_info clock_info;

static const uint32_t msi_frequency_hz[] = {
	100000U, 200000U, 400000U, 800000U, 1000000U, 2000000U,
	4000000U, 8000000U, 16000000U, 24000000U, 32000000U, 48000000U,
};

static uint32_t msi_hz(void)
{
	uint32_t range;

	if ((RCC->CR & RCC_CR_MSIRGSEL) != 0U) {
		range = (RCC->CR & RCC_CR_MSIRANGE) >> RCC_CR_MSIRANGE_Pos;
	} else {
		range = (RCC->CSR & RCC_CSR_MSISRANGE) >> RCC_CSR_MSISRANGE_Pos;
	}
	return range < ARRAY_SIZE(msi_frequency_hz) ? msi_frequency_hz[range] : 0U;
}

static uint32_t pll_r_hz(void)
{
	uint32_t pll = RCC->PLLCFGR;
	uint32_t source;
	uint32_t m = ((pll & RCC_PLLCFGR_PLLM) >> RCC_PLLCFGR_PLLM_Pos) + 1U;
	uint32_t n = (pll & RCC_PLLCFGR_PLLN) >> RCC_PLLCFGR_PLLN_Pos;
	uint32_t r = 2U * (((pll & RCC_PLLCFGR_PLLR) >> RCC_PLLCFGR_PLLR_Pos) + 1U);

	switch (pll & RCC_PLLCFGR_PLLSRC) {
	case RCC_PLLCFGR_PLLSRC_MSI:
		source = msi_hz();
		break;
	case RCC_PLLCFGR_PLLSRC_HSI:
		source = HSI16_HZ;
		break;
	case RCC_PLLCFGR_PLLSRC_HSE:
		source = HSE_HZ;
		break;
	default:
		return 0U;
	}
	if (source == 0U || n == 0U || (pll & RCC_PLLCFGR_PLLREN) == 0U) {
		return 0U;
	}
	return (uint32_t)(((uint64_t)source * n) / ((uint64_t)m * r));
}

static uint32_t sysclk_hz(void)
{
	switch (RCC->CFGR & RCC_CFGR_SWS) {
	case RCC_CFGR_SWS_MSI:
		return msi_hz();
	case RCC_CFGR_SWS_HSI:
		return HSI16_HZ;
	case RCC_CFGR_SWS_HSE:
		return HSE_HZ;
	case RCC_CFGR_SWS_PLL:
		return pll_r_hz();
	default:
		return 0U;
	}
}

static uint32_t ahb_divisor(void)
{
	static const uint16_t divisors[] = {
		1U, 1U, 1U, 1U, 1U, 1U, 1U, 1U,
		2U, 4U, 8U, 16U, 64U, 128U, 256U, 512U,
	};
	return divisors[(RCC->CFGR & RCC_CFGR_HPRE) >> RCC_CFGR_HPRE_Pos];
}

static uint32_t apb2_divisor(void)
{
	static const uint8_t divisors[] = {1U, 1U, 1U, 1U, 2U, 4U, 8U, 16U};
	return divisors[(RCC->CFGR & RCC_CFGR_PPRE2) >> RCC_CFGR_PPRE2_Pos];
}

static int derive_clock(struct usart1_clock_info *info)
{
	uint32_t selector = (RCC->CCIPR & RCC_CCIPR_USART1SEL) >> RCC_CCIPR_USART1SEL_Pos;
	uint32_t sysclk = sysclk_hz();
	uint32_t pclk2;

	/* Zephyr's board value describes HCLK; verify it against the live SYSCLK
	 * source and AHB prescaler before deriving PCLK2.
	 */
	if (sysclk == 0U || sysclk / ahb_divisor() != CONFIG_SYS_CLOCK_HW_CYCLES_PER_SEC) {
		return -EINVAL;
	}
	pclk2 = sysclk / ahb_divisor() / apb2_divisor();

	info->sysclk_hz = sysclk;
	info->pclk2_hz = pclk2;
	info->usart1_clock_source = (uint8_t)selector;
	info->apb2_divisor = (uint8_t)apb2_divisor();
	switch (selector) {
	case 0U:
		info->peripheral_hz = pclk2;
		break;
	case 1U:
		info->peripheral_hz = sysclk;
		break;
	case 2U:
		info->peripheral_hz = HSI16_HZ;
		break;
	case 3U:
		info->peripheral_hz = LSE_HZ;
		break;
	default:
		return -EINVAL;
	}
	info->brr = (info->peripheral_hz + (USART1_BAUD_RATE / 2U)) / USART1_BAUD_RATE;
	if (info->brr < 16U || info->brr > UINT16_MAX) {
		return -ERANGE;
	}
	info->nominal_baud = info->peripheral_hz / info->brr;
	return 0;
}

static void usart1_isr(const void *unused)
{
	uint32_t status = USART1->ISR;
	uint32_t clear = 0U;
	uint8_t byte;

	ARG_UNUSED(unused);
	if ((status & USART_ISR_PE) != 0U) {
		saturating_increment_u32(&errors.parity);
		clear |= USART_ICR_PECF;
	}
	if ((status & USART_ISR_FE) != 0U) {
		saturating_increment_u32(&errors.framing);
		clear |= USART_ICR_FECF;
	}
	if ((status & USART_ISR_NE) != 0U) {
		saturating_increment_u32(&errors.noise);
		clear |= USART_ICR_NCF;
	}
	if ((status & USART_ISR_ORE) != 0U) {
		saturating_increment_u32(&errors.overrun);
		clear |= USART_ICR_ORECF;
	}
	if ((status & USART_ISR_RXNE) != 0U) {
		byte = (uint8_t)USART1->RDR;
		if (!byte_ring_push(&rx_ring, byte)) {
			saturating_increment_u32(&errors.ring_overflow);
		}
	}
	if (clear != 0U) {
		USART1->ICR = clear;
	}
}

int usart1_transport_init(void)
{
	int result;
	uint32_t ignored;

	byte_ring_init(&rx_ring);
	errors = (struct usart1_error_counters){0};

	RCC->AHB2ENR |= RCC_AHB2ENR_GPIOAEN;
	RCC->APB2ENR |= RCC_APB2ENR_USART1EN;
	(void)RCC->APB2ENR;

	/* PA9/PA10: alternate-function mode, AF7; PA10 has a weak pull-up. */
	GPIOA->MODER = (GPIOA->MODER & ~((3UL << (9U * 2U)) | (3UL << (10U * 2U)))) |
		       (2UL << (9U * 2U)) | (2UL << (10U * 2U));
	GPIOA->OTYPER &= ~((1UL << 9U) | (1UL << 10U));
	GPIOA->OSPEEDR |= (3UL << (9U * 2U)) | (3UL << (10U * 2U));
	GPIOA->PUPDR = (GPIOA->PUPDR & ~((3UL << (9U * 2U)) | (3UL << (10U * 2U)))) |
		       (1UL << (10U * 2U));
	GPIOA->AFR[1] = (GPIOA->AFR[1] & ~((0xFUL << 4U) | (0xFUL << 8U))) |
			(7UL << 4U) | (7UL << 8U);

	USART1->CR1 = 0U;
	USART1->CR2 = 0U;
	USART1->CR3 = 0U;
	result = derive_clock(&clock_info);
	if (result < 0) {
		return result;
	}
	USART1->BRR = clock_info.brr;

	/* Drain stale data and clear all receive/error state before IRQ enable. */
	ignored = USART1->RDR;
	ARG_UNUSED(ignored);
	USART1->ICR = USART1_ERROR_CLEARS;
	IRQ_CONNECT(USART1_IRQn, 1, usart1_isr, NULL, 0);
	irq_enable(USART1_IRQn);
	USART1->CR3 = USART_CR3_EIE;
	USART1->CR1 = USART_CR1_RE | USART_CR1_TE | USART_CR1_RXNEIE |
		       USART_CR1_PEIE | USART_CR1_UE;
	return 0;
}

int usart1_transport_write(const uint8_t *data, size_t length)
{
	if (data == NULL && length != 0U) {
		return -EINVAL;
	}
	for (size_t i = 0U; i < length; ++i) {
		while ((USART1->ISR & USART_ISR_TXE) == 0U) {
		}
		USART1->TDR = data[i];
	}
	if (length != 0U) {
		while ((USART1->ISR & USART_ISR_TC) == 0U) {
		}
	}
	return 0;
}

bool usart1_transport_read(uint8_t *byte)
{
	return byte_ring_pop(&rx_ring, byte);
}

size_t usart1_transport_rx_count(void)
{
	return byte_ring_count(&rx_ring);
}

void usart1_transport_get_errors(struct usart1_error_counters *snapshot)
{
	unsigned int key;

	if (snapshot == NULL) {
		return;
	}
	key = irq_lock();
	*snapshot = errors;
	irq_unlock(key);
}

void usart1_transport_get_clock(struct usart1_clock_info *snapshot)
{
	if (snapshot != NULL) {
		*snapshot = clock_info;
	}
}
```
